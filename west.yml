## west.yml
```yaml
# The west manifest file for upstream Zephyr.
#
# The per-installation west configuration file, .west/config, sets the
# path to the project containing this file in the [manifest] section's
# "path" variable.
#
# You are free to create your own manifest files and put them in any
# repository you want, to create your own custom Zephyr installations.
# For example, you could create a manifest file in your own out of
# tree application directory, which would pull this zephyr repository
# in as an ordinary project.
#
# You can pass your manifest repositories to west init when creating a
# new Zephyr installation. See the west documentation for more
# information.

manifest:
  defaults:
    remote: upstream

  remotes:
    - name: upstream
      url-base: https://github.com/zephyrproject-rtos

  group-filter: [-babblesim]

  #
  # Please add items below based on alphabetical order
  projects:
    - name: bsim
      repo-path: babblesim-manifest
      revision: 908ffde6298a937c6549dbfa843a62caab26bfc5
      import:
        path-prefix: tools
    - name: canopennode
      revision: dec12fa3f0d790cafa8414a4c2930ea71ab72ffd
      path: modules/lib/canopennode
    - name: chre
      revision: b7955c27e50485b7dafdc3888d7d6afdc2ac6d96
      path: modules/lib/chre
    - name: cmsis
      revision: 74981bf893e8b10931464b9945e2143d99a3f0a3
      path: modules/hal/cmsis
      groups:
        - hal
    - name: edtt
      revision: 64e5105ad82390164fb73fc654be3f73a608209a
      path: tools/edtt
      groups:
        - tools
    - name: fatfs
      revision: 427159bf95ea49b7680facffaa29ad506b42709b
      path: modules/fs/fatfs
      groups:
        - fs
    - name: hal_espressif
      # revision: e41b0876c8bb0b9f90846c14397beff52d5590b4
      # revision: 73e7af1e2ed64571ce49ff9f07dc02690b9f2df5
      # revision: 8ee96508f329c7e59fcbf739f060cf12082dd805
      revision: 8e5da13712012d2cc480f7abc699235352153e05
      path: modules/hal/espressif
      west-commands: west/west-commands.yml
      groups:
        - hal
    - name: hal_xtensa
      revision: 63f655362423aa49507da7977a2d37142e8debeb
      path: modules/hal/xtensa
      groups:
        - hal
    - name: libmetal
      revision: efa2ace6028290ddee494a78ade772a0b112ab83
      path: modules/hal/libmetal
      groups:
        - hal
    - name: littlefs
      path: modules/fs/littlefs
      groups:
        - fs
      revision: ca583fd297ceb48bced3c2548600dc615d67af24
    - name: loramac-node
      revision: ce57712f3e426bbbb13acaec97b45369f716f43a
      path: modules/lib/loramac-node
    - name: lz4
      revision: 8e303c264fc21c2116dc612658003a22e933124d
      path: modules/lib/lz4
    - name: mbedtls
      revision: 4e1f66df894dc622da7bcd3884016a6ace08e9ea
      path: modules/crypto/mbedtls
      groups:
        - crypto
    - name: mcuboot
      revision: 6902abba270c0fbcbe8ee3bb56fe39bc9acc2774
      path: bootloader/mcuboot
    - name: mipi-sys-t
      path: modules/debug/mipi-sys-t
      groups:
        - debug
      revision: 0d521d8055f3b2b4842f728b0365d3f0ece9c37f
    - name: nanopb
      revision: 42fa8b211e946b90b9d968523fce7b1cfe27617e
      path: modules/lib/nanopb
    - name: net-tools
      revision: e0828aa9629b533644dc96ff6d1295c939bd713c
      path: tools/net-tools
      groups:
        - tools
    - name: nrf_hw_models
      revision: bad9877e997b2c2a78dd74eec8978181f4655d14
      path: modules/bsim_hw_models/nrf_hw_models
    - name: open-amp
      revision: 233fb29c52ffa7733ba132a2b5987a8201ba8ec6
      path: modules/lib/open-amp
    - name: openthread
      revision: 7bdcf8a5d49838ce6e3e227e2780e4f12c461330
      path: modules/lib/openthread
    - name: picolibc
      path: modules/lib/picolibc
      revision: 93b5d5f2ad44867b60267417cd6d6250dbf68983
    - name: segger
      revision: 4bfaf28a11c3e5ec29badac744fab6d2f342749e
      path: modules/debug/segger
      groups:
        - debug
    - name: sof
      revision: ac71254757478f79aa88807c168e88aee70a330b
      path: modules/audio/sof
    - name: tflite-micro
      revision: 9156d050927012da87079064db59d07f03b8baf6
      path: modules/lib/tflite-micro
      repo-path: tflite-micro
    - name: tinycrypt
      revision: 3e9a49d2672ec01435ffbf0d788db6d95ef28de0
      path: modules/crypto/tinycrypt
      groups:
        - crypto
    - name: TraceRecorderSource
      revision: bc839bf94904bcdb91b33760e918afbef82e3ab4
      path: modules/debug/TraceRecorder
      groups:
        - debug
    - name: trusted-firmware-m
      revision: 0e25742e8023a0c823c825fbaf19ea265162cc56
      path: modules/tee/tf-m/trusted-firmware-m
      groups:
        - tee
    - name: trusted-firmware-a
      revision: 28f5e137837f1c1a7a7b2af2dd8bb778c0a27532
      path: modules/tee/tf-a/trusted-firmware-a
      groups:
        - tee
    - name: tf-m-tests
      revision: 0f80a65193ddbbe3f0ac38b33b07b26138c11fa7
      path: modules/tee/tf-m/tf-m-tests
      groups:
        - tee
    - name: psa-arch-tests
      revision: 6a17330e0dfb5f319730f974d5b05f7b7f04757b
      path: modules/tee/tf-m/psa-arch-tests
      groups:
        - tee
    - name: uoscore-uedhoc
      revision: e8920192b66db4f909eb9cd3f155d5245c1ae825
      path: modules/lib/uoscore-uedhoc
    - name: zcbor
      revision: 67fd8bb88d3136738661fa8bb5f9989103f4599e
      path: modules/lib/zcbor
    - name: zscilib
      path: modules/lib/zscilib
      revision: 0035be5e6a45e4ab89755b176d305d7a877fc79c
    - name: thrift
      path: modules/lib/thrift
      revision: 10023645a0e6cb7ce23fcd7fd3dbac9f18df6234

  self:
    path: zephyr
    west-commands: scripts/west-commands.yml
    import: submanifests
```
